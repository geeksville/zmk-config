## config/west.yml
```yaml
manifest:
  defaults:
    revision: v0.3
  remotes:
  - name: zmkfirmware
    url-base: https://github.com/zmkfirmware
    # Additional modules containing boards/shields/custom code can be listed here as well
    # See https://docs.zephyrproject.org/3.2.0/develop/west/manifest.html#projects
  projects:
  - name: zmk
    remote: zmkfirmware
    import: app/west.yml
  - name: corne-j-geeksville
    url: https://github.com/geeksville/corne-j-geeksville
    revision: main
    path: modules/corne-j-geeksville
  self:
    path: config
```
